/* AUTO-GENERATED by scripts/generate_profile_test_matrix.py — do not edit. */
struct ProfileMatrixCase {
  const char *role;
  const char *product_profile;
  bool surplus_regulation;
  bool triac;
  bool multi_action;
  bool source_test_inject;
};
static const ProfileMatrixCase kProfileMatrixCases[] = {
  {"meter_router", "jsy_mk194_router", true, true, false, false},
  {"meter_gateway", "jsy_mk194_meter", false, false, false, false},
  {"meter_router", "jsy_mk333_router", true, true, false, false},
  {"meter_gateway", "jsy_mk333_meter", false, false, false, false},
  {"meter_router", "analog_router", true, true, false, false},
  {"meter_gateway", "analog_meter", false, false, false, false},
  {"meter_router", "linky_router", true, true, false, false},
  {"meter_gateway", "linky_meter", false, false, false, false},
  {"meter_router", "enphase_router", true, true, false, false},
  {"meter_gateway", "enphase_meter", false, false, false, false},
  {"meter_router", "shelly_em_router", true, true, false, false},
  {"meter_gateway", "shelly_em_meter", false, false, false, false},
  {"meter_router", "shelly_pro_router", true, true, false, false},
  {"meter_gateway", "shelly_pro_meter", false, false, false, false},
  {"meter_router", "smartg_router", true, true, false, false},
  {"meter_gateway", "smartg_meter", false, false, false, false},
  {"meter_router", "homew_router", true, true, false, false},
  {"meter_gateway", "homew_meter", false, false, false, false},
  {"meter_router", "pmqtt_router", true, true, false, false},
  {"meter_gateway", "pmqtt_meter", false, false, false, false},
  {"meter_router", "balansun_peer_router", true, true, false, false},
  {"meter_gateway", "balansun_peer_meter", false, false, false, false},
  {"meter_router", "jsy_mk194_router", true, true, false, false},
  {"meter_gateway", "jsy_mk194_meter", false, false, false, false},
  {"full_router", "full_router", true, true, true, true},
  {"full_router", "full_router", true, true, true, true},
  {"full_router", "full_router", true, true, true, true},
};
static const size_t kProfileMatrixCaseCount = 27;
