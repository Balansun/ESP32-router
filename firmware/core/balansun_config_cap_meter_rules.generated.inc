/* AUTO-GENERATED by scripts/generate_meter_pack.py — do not edit. */
    {"calib_i", BalansunConfigCapRuleKind::MeterWire, {.meter_wire = "Analog"}},
    {"calib_u", BalansunConfigCapRuleKind::MeterWire, {.meter_wire = "Analog"}},
    {"enphase_password", BalansunConfigCapRuleKind::MeterWire, {.meter_wire = "Enphase"}},
    {"enphase_serial", BalansunConfigCapRuleKind::MeterWire, {.meter_wire = "Enphase"}},
    {"enphase_user", BalansunConfigCapRuleKind::MeterWire, {.meter_wire = "Enphase"}},
    {"ext_peer_ip", BalansunConfigCapRuleKind::MeterWire, {.meter_wire = "HomeW"}},
    {"ext_peer_path", BalansunConfigCapRuleKind::MeterWire, {.meter_wire = "BalansunPeer"}},
    {"ext_peer_port", BalansunConfigCapRuleKind::MeterWire, {.meter_wire = "BalansunPeer"}},
    {"ext_protocol", BalansunConfigCapRuleKind::MeterWire, {.meter_wire = "BalansunPeer"}},
    {"jsy_mk333_serial_baud", BalansunConfigCapRuleKind::MeterWire, {.meter_wire = "JsyMk333"}},
    {"meter_channel", BalansunConfigCapRuleKind::MeterWire, {.meter_wire = "ShellyPro"}},
    {"pmqtt_bindings", BalansunConfigCapRuleKind::MeterWire, {.meter_wire = "Pmqtt"}},
    {"pmqtt_schema", BalansunConfigCapRuleKind::MeterWire, {.meter_wire = "Pmqtt"}},
    {"pmqtt_topic", BalansunConfigCapRuleKind::MeterWire, {.meter_wire = "Pmqtt"}},
    {"tempo_rte_enabled", BalansunConfigCapRuleKind::MeterWire, {.meter_wire = "Linky"}},
